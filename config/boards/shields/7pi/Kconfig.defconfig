## config/boards/shields/7pi/Kconfig.defconfig
```kconfig
config ZMK_BLE
	default y

config ZMK_USB
	default y

if SHIELD_7PI_DONGLE

config ZMK_KEYBOARD_NAME
	default "7pi"

endif



if SHIELD_7PI_DONGLE_LEFT || SHIELD_7PI_DONGLE_RIGHT

config ZMK_SPLIT
	default y

endif



if SHIELD_7PI_DONGLE

config ZMK_SPLIT
	default y

config ZMK_SPLIT_BLE_ROLE_CENTRAL
	default y

endif
```

## config/boards/shields/7pi/Kconfig.shield
```kconfig
config SHIELD_7PI_DONGLE
	def_bool $(shields_list_contains,7pi_dongle)
	
config SHIELD_7PI_DONGLE_LEFT
	def_bool $(shields_list_contains,7pi_dongle_left)

config SHIELD_7PI_DONGLE_RIGHT
	def_bool $(shields_list_contains,7pi_dongle_right)
	
```

## config/west.yml
```yaml
manifest:
  remotes:
    - name: nick
      url-base: https://github.com/nkearbey
  projects:
    - name: zmk
      remote: nick
      revision: init
      import: app/west.yml
  self:
    path: config
```
